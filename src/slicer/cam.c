#include "cam.h"
#include <stdio.h>
#include <math.h>
#include <string.h>

#ifndef M_PI
#define M_PI 3.14159265358979
#endif

void cam_defaults(CamSettings *s) {
    memset(s, 0, sizeof(*s));
    s->tool.diameter = 1.6f;
    s->tool.spindle_rpm = 12000;
    s->tool.feed_xy = 800.0f;
    s->tool.feed_z = 200.0f;
    s->tool.depth_per_pass = 0.5f;
    s->safe_z = 5.0f;
    s->retract_z = 2.0f;
    s->clearance_xy = 0.0f;
    s->stepover = 0.4f;
}

static void cam_header(FILE *f, const CamSettings *s) {
    fprintf(f, "; CNC G-code generated by Volt360 CAM\n");
    fprintf(f, "; Tool: %.1fmm end mill, %d RPM, feed XY=%.0f Z=%.0f mm/min\n",
            s->tool.diameter, s->tool.spindle_rpm, s->tool.feed_xy, s->tool.feed_z);
    fprintf(f, "G21 ; mm\nG90 ; absolute\nG17 ; XY plane\n");
    fprintf(f, "G0 Z%.3f\n", s->safe_z);
    fprintf(f, "M3 S%d ; spindle on\n", s->tool.spindle_rpm);
    fprintf(f, "G4 P2 ; dwell for spin-up\n");
}

static void cam_footer(FILE *f, const CamSettings *s) {
    fprintf(f, "G0 Z%.3f\n", s->safe_z);
    fprintf(f, "M5 ; spindle off\n");
    fprintf(f, "G0 X0 Y0\n");
    fprintf(f, "M30 ; end program\n");
}

static void cam_rapid(FILE *f, float x, float y, float z) {
    fprintf(f, "G0 X%.3f Y%.3f Z%.3f\n", x, y, z);
}

static void cam_feed_xy(FILE *f, float x, float y, const CamSettings *s) {
    fprintf(f, "G1 X%.3f Y%.3f F%.0f\n", x, y, s->tool.feed_xy);
}

static void cam_feed_z(FILE *f, float z, const CamSettings *s) {
    fprintf(f, "G1 Z%.3f F%.0f\n", z, s->tool.feed_z);
}

// ================= Face =================
bool cam_face(const char *path, const CamSettings *s, float x, float y, float w, float h, float target_z) {
    if (!path || !s || w <= 0 || h <= 0 || s->tool.depth_per_pass <= 0) return false;
    FILE *f = fopen(path, "w"); if (!f) return false;
    cam_header(f, s);
    float step = s->tool.diameter * s->stepover;
    float z = 0;
    while (z > target_z) {
        z -= s->tool.depth_per_pass;
        if (z < target_z) z = target_z;
        cam_rapid(f, x, y, s->safe_z);
        cam_feed_z(f, z, s);
        bool dir = true;
        for (float yy = y; yy < y + h; yy += step) {
            if (dir) { cam_feed_xy(f, x + w, yy, s); cam_feed_xy(f, x + w, yy + step, s); }
            else { cam_feed_xy(f, x, yy + step, s); cam_feed_xy(f, x, yy, s); }
            dir = !dir;
        }
        cam_rapid(f, x, y, s->retract_z);
    }
    cam_footer(f, s); fclose(f); return true;
}

// ================= Profile =================
bool cam_profile(const char *path, const CamSettings *s, V2 *poly, int n, float target_z) {
    if (!path || n < 3 || s->tool.depth_per_pass <= 0) return false;
    FILE *f = fopen(path, "w"); if (!f) return false;
    cam_header(f, s);
    float z = 0;
    while (z > target_z) {
        z -= s->tool.depth_per_pass;
        if (z < target_z) z = target_z;
        cam_rapid(f, poly[0].x, poly[0].y, s->safe_z);
        cam_feed_z(f, z, s);
        cam_feed_xy(f, poly[0].x, poly[0].y, s);
        for (int i = 1; i < n; i++) cam_feed_xy(f, poly[i].x, poly[i].y, s);
        cam_feed_xy(f, poly[0].x, poly[0].y, s); // close loop
        cam_rapid(f, poly[0].x, poly[0].y, s->retract_z);
    }
    cam_footer(f, s); fclose(f); return true;
}

// ================= Pocket =================
bool cam_pocket(const char *path, const CamSettings *s, V2 *poly, int n, float target_z) {
    if (!path || n < 3 || s->tool.depth_per_pass <= 0) return false;
    FILE *f = fopen(path, "w"); if (!f) return false;
    cam_header(f, s);
    // compute bounding box
    float mnx = poly[0].x, mny = poly[0].y, mxx = mnx, mxy = mny;
    for (int i = 1; i < n; i++) {
        if (poly[i].x < mnx) mnx = poly[i].x; if (poly[i].x > mxx) mxx = poly[i].x;
        if (poly[i].y < mny) mny = poly[i].y; if (poly[i].y > mxy) mxy = poly[i].y;
    }
    float step = s->tool.diameter * s->stepover;
    // simple point-in-poly test for pocket roughing
    float z = 0;
    while (z > target_z) {
        z -= s->tool.depth_per_pass;
        if (z < target_z) z = target_z;
        cam_rapid(f, mnx + step, mny + step, s->safe_z);
        cam_feed_z(f, z, s);
        bool dir = true;
        for (float yy = mny + step; yy < mxy; yy += step) {
            if (dir) { cam_feed_xy(f, mxx - step, yy, s); cam_feed_xy(f, mxx - step, yy + step, s); }
            else { cam_feed_xy(f, mnx + step, yy + step, s); cam_feed_xy(f, mnx + step, yy, s); }
            dir = !dir;
        }
        // finish pass: profile the boundary
        cam_rapid(f, poly[0].x, poly[0].y, s->retract_z);
        cam_feed_z(f, z, s);
        cam_feed_xy(f, poly[0].x, poly[0].y, s);
        for (int i = 1; i < n; i++) cam_feed_xy(f, poly[i].x, poly[i].y, s);
        cam_feed_xy(f, poly[0].x, poly[0].y, s);
        cam_rapid(f, mnx + step, mny + step, s->retract_z);
    }
    cam_footer(f, s); fclose(f); return true;
}

// ================= Drill =================
bool cam_drill(const char *path, const CamSettings *s, V2 *holes, int n, float target_z, float peck_delta) {
    if (!path || n <= 0) return false;
    FILE *f = fopen(path, "w"); if (!f) return false;
    cam_header(f, s);
    for (int i = 0; i < n; i++) {
        cam_rapid(f, holes[i].x, holes[i].y, s->safe_z);
        float z = 0;
        while (z > target_z) {
            z -= peck_delta > 0 ? peck_delta : s->tool.depth_per_pass;
            if (z < target_z) z = target_z;
            cam_feed_z(f, z, s);
            cam_rapid(f, holes[i].x, holes[i].y, (z > target_z) ? s->retract_z : s->safe_z);
        }
    }
    cam_footer(f, s); fclose(f); return true;
}

// ================= PCB isolation routing =================
bool cam_pcb_isolate(const char *path, const CamSettings *s, Pcb *pcb, float isolation_width, float target_z) {
    if (!path || !pcb || pcb->ntracks <= 0) return false;
    FILE *f = fopen(path, "w"); if (!f) return false;
    cam_header(f, s);
    float z = 0;
    while (z > target_z) {
        z -= s->tool.depth_per_pass;
        if (z < target_z) z = target_z;
        // first pass: rough
        for (int i = 0; i < pcb->ntracks; i++) {
            cam_rapid(f, pcb->tracks[i].a.x, pcb->tracks[i].a.y, s->safe_z);
            cam_feed_z(f, z, s);
            cam_feed_xy(f, pcb->tracks[i].a.x, pcb->tracks[i].a.y, s);
            cam_feed_xy(f, pcb->tracks[i].b.x, pcb->tracks[i].b.y, s);
        }
        // second pass: offset pass for isolation width
        if (isolation_width > 0) {
            for (int i = 0; i < pcb->ntracks; i++) {
                V2 a = pcb->tracks[i].a, b = pcb->tracks[i].b;
                V2 d = v2(b.x - a.x, b.y - a.y);
                float len = sqrtf(d.x * d.x + d.y * d.y);
                if (len < 0.001f) continue;
                V2 n = v2(-d.y / len, d.x / len);
                float off = isolation_width + s->tool.diameter * 0.5f;
                cam_rapid(f, a.x + n.x * off, a.y + n.y * off, s->safe_z);
                cam_feed_z(f, z, s);
                cam_feed_xy(f, a.x + n.x * off, a.y + n.y * off, s);
                cam_feed_xy(f, b.x + n.x * off, b.y + n.y * off, s);
                cam_rapid(f, a.x - n.x * off, a.y - n.y * off, s->safe_z);
                cam_feed_z(f, z, s);
                cam_feed_xy(f, a.x - n.x * off, a.y - n.y * off, s);
                cam_feed_xy(f, b.x - n.x * off, b.y - n.y * off, s);
            }
        }
        cam_rapid(f, pcb->tracks[0].a.x, pcb->tracks[0].a.y, s->retract_z);
    }
    cam_footer(f, s); fclose(f); return true;
}

// ================= PCB outline cutting =================
bool cam_pcb_outline(const char *path, const CamSettings *s, Pcb *pcb, float target_z, int n_tabs, float tab_width) {
    if (!path || !pcb || pcb->noutline < 3) return false;
    FILE *f = fopen(path, "w"); if (!f) return false;
    cam_header(f, s);
    float z = 0;
    while (z > target_z) {
        z -= s->tool.depth_per_pass;
        if (z < target_z) z = target_z;
        float total_len = 0;
        float seg_lens[128]; int ns = pcb->noutline < 128 ? pcb->noutline : 128;
        for (int i = 0; i < pcb->noutline; i++) {
            int j = (i + 1) % pcb->noutline;
            V2 d = v2(pcb->outline[j].x - pcb->outline[i].x, pcb->outline[j].y - pcb->outline[i].y);
            seg_lens[i] = sqrtf(d.x * d.x + d.y * d.y);
            total_len += seg_lens[i];
        }
        float tab_space = (n_tabs > 0) ? total_len / (float)(n_tabs + 1) : total_len;
        float dist = 0;
        cam_rapid(f, pcb->outline[0].x, pcb->outline[0].y, s->safe_z);
        cam_feed_z(f, z, s);
        cam_feed_xy(f, pcb->outline[0].x, pcb->outline[0].y, s);
        int tab_idx = 0;
        for (int i = 0; i < pcb->noutline; i++) {
            int j = (i + 1) % pcb->noutline;
            // tabs: skip cutting through tab regions
            bool in_tab = false;
            if (n_tabs > 0 && tab_width > 0) {
                for (int t = 1; t <= n_tabs; t++) {
                    float tab_pos = tab_space * (float)t;
                    if (dist <= tab_pos && dist + seg_lens[i] >= tab_pos) in_tab = true;
                }
            }
            if (!in_tab) cam_feed_xy(f, pcb->outline[j].x, pcb->outline[j].y, s);
            else { cam_rapid(f, pcb->outline[j].x, pcb->outline[j].y, s->retract_z); cam_rapid(f, pcb->outline[j].x, pcb->outline[j].y, s->safe_z); cam_feed_z(f, z, s); cam_feed_xy(f, pcb->outline[j].x, pcb->outline[j].y, s); }
            dist += seg_lens[i];
        }
        cam_rapid(f, pcb->outline[0].x, pcb->outline[0].y, s->retract_z);
    }
    cam_footer(f, s); fclose(f); return true;
}
