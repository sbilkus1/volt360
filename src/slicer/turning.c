#include "turning.h"
#include <stdio.h>
#include <string.h>
#include <math.h>

void turn_tool_defaults(TurnTool *t) {
    t->spindle_rpm = 1500;
    t->feed_mm_rev = 0.15f;
    t->doc_mm = 1.0f;
    t->safe_x = 10.0f;
    t->safe_z = 5.0f;
}

static void t_header(FILE *f, TurnTool *t) {
    fprintf(f, "; Lathe G-code generated by Volt360 CAM\n");
    fprintf(f, "G21 ; mm\nG90 ; absolute\nG18 ; XZ plane (lathe)\n");
    fprintf(f, "G0 X%.3f Z%.3f\n", t->safe_x, t->safe_z);
    fprintf(f, "M3 S%d ; spindle on\n", t->spindle_rpm);
}

static void t_footer(FILE *f, TurnTool *t) {
    fprintf(f, "G0 X%.3f Z%.3f\n", t->safe_x, t->safe_z);
    fprintf(f, "M5 ; spindle off\nM30 ; end\n");
}

bool turn_face(const char *path, TurnTool *t, float start_diam, float target_z, int passes) {
    if (!path || start_diam <= 0 || passes <= 0) return false;
    FILE *f = fopen(path, "w"); if (!f) return false;
    t_header(f, t);
    float r = start_diam * 0.5f;
    float step = r / (float)passes;
    for (int i = 0; i < passes; i++) {
        float x = r - step * (float)i;
        fprintf(f, "G0 Z%.3f\n", target_z + 2.0f);
        fprintf(f, "G0 X%.3f\n", x * 2.0f);
        fprintf(f, "G1 Z%.3f F%.3f\n", target_z, t->feed_mm_rev * (float)t->spindle_rpm);
        fprintf(f, "G1 X%.3f F%.3f\n", (r - step * (float)(i + 1)) * 2.0f, t->feed_mm_rev * (float)t->spindle_rpm);
        fprintf(f, "G0 X%.3f\n", t->safe_x);
    }
    t_footer(f, t); fclose(f); return true;
}

bool turn_cyl(const char *path, TurnTool *t, float start_diam, float target_diam, float length_z, int passes) {
    if (!path || start_diam <= 0 || target_diam <= 0 || passes <= 0) return false;
    FILE *f = fopen(path, "w"); if (!f) return false;
    t_header(f, t);
    float depth = (start_diam - target_diam) * 0.5f;
    if (depth <= 0) { fclose(f); return false; }
    int npass = passes;
    float doc = depth / (float)npass;
    for (int p = 0; p < npass; p++) {
        float x = start_diam * 0.5f - doc * (float)(p + 1);
        fprintf(f, "G0 Z%.3f\n", t->safe_z);
        fprintf(f, "G0 X%.3f\n", x * 2.0f);
        fprintf(f, "G1 Z%.3f F%.3f\n", -length_z, t->feed_mm_rev * (float)t->spindle_rpm);
        fprintf(f, "G1 X%.3f F%.3f\n", t->safe_x, t->feed_mm_rev * (float)t->spindle_rpm);
    }
    t_footer(f, t); fclose(f); return true;
}

bool turn_groove(const char *path, TurnTool *t, float diam, float groove_diam, float groove_width, float z_start) {
    if (!path || diam <= 0 || groove_diam >= diam) return false;
    FILE *f = fopen(path, "w"); if (!f) return false;
    t_header(f, t);
    float depth = (diam - groove_diam) * 0.5f;
    int npass = (int)(depth / t->doc_mm) + 1;
    float doc = depth / (float)npass;
    for (int p = 0; p < npass; p++) {
        float x = diam * 0.5f - doc * (float)(p + 1);
        fprintf(f, "G0 X%.3f\n", x * 2.0f);
        fprintf(f, "G0 Z%.3f\n", z_start);
        fprintf(f, "G1 Z%.3f F%.3f\n", z_start - groove_width, t->feed_mm_rev * (float)t->spindle_rpm * 0.3f);
        fprintf(f, "G0 X%.3f\n", t->safe_x);
    }
    t_footer(f, t); fclose(f); return true;
}

bool turn_thread(const char *path, TurnTool *t, float major_diam, float minor_diam, float pitch, float length_z, int passes) {
    if (!path || major_diam <= 0 || minor_diam <= 0 || pitch <= 0 || passes <= 0) return false;
    FILE *f = fopen(path, "w"); if (!f) return false;
    t_header(f, t);
    float depth = (major_diam - minor_diam) * 0.5f;
    float doc_per_pass = depth / (float)passes;
    for (int p = 0; p < passes; p++) {
        float x = major_diam * 0.5f - doc_per_pass * (float)(p + 1);
        fprintf(f, "; Thread pass %d/%d diameter=%.3f\n", p+1, passes, x*2);
        fprintf(f, "G0 X%.3f Z%.3f\n", x * 2.0f, t->safe_z);
        fprintf(f, "G32 Z%.3f F%.3f ; threading\n", -length_z, pitch);
        fprintf(f, "G0 X%.3f\n", t->safe_x);
    }
    t_footer(f, t); fclose(f); return true;
}

bool turn_partoff(const char *path, TurnTool *t, float diam, float z_pos) {
    if (!path || diam <= 0) return false;
    FILE *f = fopen(path, "w"); if (!f) return false;
    t_header(f, t);
    fprintf(f, "G0 Z%.3f\n", z_pos);
    fprintf(f, "G0 X%.3f\n", diam + 2.0f);
    fprintf(f, "G1 X-1.0 F%.3f ; part off\n", t->feed_mm_rev * (float)t->spindle_rpm * 0.2f);
    t_footer(f, t); fclose(f); return true;
}
